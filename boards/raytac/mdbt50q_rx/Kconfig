## boards/raytac/mdbt50q_rx/Kconfig
```kconfig
# Raytac MDBT50Q-RX board configuration

# Copyright (c) 2022 Nikola Trifunovic
# Copyright (c) 2018 Nordic Semiconductor ASA
# SPDX-License-Identifier: Apache-2.0

if BOARD_RAYTAC_MDBT50Q_RX

config BOARD_ENABLE_DCDC
	bool "DCDC mode"
	select SOC_DCDC_NRF52X
	default y

endif # BOARD_RAYTAC_MDBT50Q_RX
```

## boards/raytac/mdbt50q_rx/Kconfig.raytac_mdbt50q_rx
```kconfig
# Raytac MDBT50Q-RX board configuration

# Copyright (c) 2022 Nikola Trifunovic
# Copyright (c) 2018 Nordic Semiconductor ASA
# SPDX-License-Identifier: Apache-2.0

config BOARD_RAYTAC_MDBT50Q_RX
	select SOC_NRF52840_QIAA
```
